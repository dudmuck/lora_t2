## CMakeLists.txt
```
# Copyright (c) 2024 Semtech Corporation - Félix Piédallu
# SPDX-License-Identifier: Apache-2.0

cmake_minimum_required(VERSION 3.13.1)

# create compile_commands.json for clang
set(CMAKE_EXPORT_COMPILE_COMMANDS on)

find_package(Zephyr HINTS $ENV{ZEPHYR_BASE})
project(hw_modem)

zephyr_compile_options(-fdiagnostics-color=always)

add_subdirectory(src)

target_include_directories(app PRIVATE include)

# Based on some LBM features, different flags are used in the sample for some
# reason, so we map to them here.
zephyr_compile_definitions_ifdef(CONFIG_LORA_BASICS_MODEM_GEOLOCATION
                                 ADD_APP_GEOLOCATION)

zephyr_compile_definitions_ifdef(LORA_BASICS_MODEM_CRYPTOGRAPHY_LR11XX
                                 USE_LR11XX_CRYPTO)
zephyr_compile_definitions_ifdef(
  LORA_BASICS_MODEM_CRYPTOGRAPHY_LR11XX_WITH_CREDENTIALS USE_LR11XX_CRYPTO)

zephyr_compile_definitions_ifdef(CONFIG_LORA_BASICS_MODEM_RELAY_TX_ENABLE
                                 USE_RELAY_TX)
```

## prj.conf
```kconfig
# Copyright (c) 2024 Semtech Corporation - Félix Piédallu
# SPDX-License-Identifier: Apache-2.0

CONFIG_CPP=y

CONFIG_USE_SEGGER_RTT=n

# ------------------------------ General configuration -------------------------

# required for floorf (which is used within the smtc_modem lib)
CONFIG_NEWLIB_LIBC=y

# stack size (2048 required by Semtech)
CONFIG_MAIN_STACK_SIZE=4096
# some opereations will be triggered from the system workq, so match above stack size
CONFIG_SYSTEM_WORKQUEUE_STACK_SIZE=4096
# heap size
CONFIG_HEAP_MEM_POOL_SIZE=4096

CONFIG_LOG_BUFFER_SIZE=4096

CONFIG_LOG=y
CONFIG_LOG_BACKEND_UART=y

CONFIG_TEST_RANDOM_GENERATOR=y

CONFIG_SERIAL=y
CONFIG_UART_INTERRUPT_DRIVEN=y

# ------------------------------ Transceiver driver ----------------------------
CONFIG_LORA_BASICS_MODEM_DRIVERS=y
CONFIG_LORA_BASICS_MODEM_DRIVERS_EVENT_TRIGGER_GLOBAL_THREAD=y

# ------------------------------ Requirements LBM ------------------------------

CONFIG_SETTINGS=y
CONFIG_SETTINGS_NVS=y

CONFIG_NVS=y
CONFIG_FLASH=y
CONFIG_FLASH_MAP=y

CONFIG_REBOOT=y

# ------------------------------ LoRa Basics Modem -----------------------------

CONFIG_LORA_BASICS_MODEM=y

# FIXME: maybe use SETTINGS
CONFIG_LORA_BASICS_MODEM_USER_STORAGE_IMPL=n

CONFIG_LORA_BASICS_MODEM_RP2_103=y
CONFIG_LORA_BASICS_MODEM_ENABLE_ALL_REGIONS=y

CONFIG_LORA_BASICS_MODEM_CRYPTOGRAPHY_SOFT=n

CONFIG_LORA_BASICS_MODEM_CLASS_B=y
CONFIG_LORA_BASICS_MODEM_CLASS_C=y
CONFIG_LORA_BASICS_MODEM_MULTICAST=y
CONFIG_LORA_BASICS_MODEM_CSMA=y

CONFIG_LORA_BASICS_MODEM_ALC_SYNC=y
CONFIG_LORA_BASICS_MODEM_ALC_SYNC_V2=y

CONFIG_LORA_BASICS_MODEM_FUOTA=y
# CONFIG_LORA_BASICS_MODEM_FUOTA_VERSION_1=y
# CONFIG_LORA_BASICS_MODEM_FUOTA_FMP=y
# CONFIG_LORA_BASICS_MODEM_FUOTA_MPA=y

CONFIG_LORA_BASICS_MODEM_ALMANAC=y
CONFIG_LORA_BASICS_MODEM_STREAM=y
CONFIG_LORA_BASICS_MODEM_LFU=y
CONFIG_LORA_BASICS_MODEM_DEVICE_MANAGEMENT=y
CONFIG_LORA_BASICS_MODEM_GEOLOCATION=y
CONFIG_LORA_BASICS_MODEM_STORE_AND_FORWARD=y
# CONFIG_LORA_BASICS_MODEM_BEACON_TX=y
# CONFIG_LORA_BASICS_MODEM_RELAY_TX=y


CONFIG_LORA_BASICS_MODEM_APP_HELPERS=y

# Increase required for store_and_forward
CONFIG_LORA_BASICS_MODEM_CONTEXT_BUFFER_SIZE=1024


# ------------------------------ Debug ------------------------------

# Compiler optimizations will be set to -Og independently of other options.
CONFIG_DEBUG_OPTIMIZATIONS=y

# This option enables the addition of various information that can be
# used by debuggers in debugging the system, or enable additional debugging
# information to be reported at runtime.
CONFIG_DEBUG_INFO=y

# This option adds additional information to the thread object, so that the
# debugger can discover the threads.
CONFIG_DEBUG_THREAD_INFO=y
CONFIG_DEBUG_COREDUMP=y

# enable asserts during development only
CONFIG_ASSERT=y

CONFIG_LORA_BASICS_MODEM_LOG_LEVEL_DBG=y
CONFIG_LORA_BASICS_MODEM_LOG_LEVEL_DEEP_DBG=y

# ------------------------------ Requirements of this sample ------------------------------

CONFIG_PM_DEVICE=y
CONFIG_WATCHDOG=y
```

## include/main.h
```c
#ifndef CPP_FUNCTIONS_H
#define CPP_FUNCTIONS_H

#ifdef __cplusplus
extern "C" {
#endif

int app_main(void);

#ifdef __cplusplus
}
#endif

#endif // CPP_FUNCTIONS_H
```

## include/radio_app.h
```c
#include <zephyr/kernel.h>
#include <zephyr/logging/log.h>

#define FIRST_CHIP_MENU_ROW        3
#define LAST_CHIP_MENU_ROW          (MAX_MENU_ROWS-5)

#if defined(CONFIG_SEMTECH_SX128X)
    #define MAX_MENU_ROWS             16
    #define MAX_MENU_COLUMNS           6
#elif defined(CONFIG_SEMTECH_SX126X) // or CONFIG_HAS_SEMTECH_SX126X 
	#include <sx126x_driver.h> // app header
	#include <sx126x.h> // lbm header
    //#define MEMSCAN
    #define MAX_MENU_ROWS             17
    #define MAX_MENU_COLUMNS           6
#elif defined(CONFIG_SEMTECH_SX127X)
    #define MAX_MENU_ROWS             16
    #define MAX_MENU_COLUMNS           6
#elif defined(CONFIG_SEMTECH_LR11XX)
    #define MAX_MENU_ROWS             23
    #define MAX_MENU_COLUMNS          14
#else
	#error unknown_radio
#endif

#define PA_OFF_DBM      -127

#include <stdio.h>

#define _ITEM_VALUE      0xbb
#define _ITEM_DROPDOWN   0xaa
#define _ITEM_BUTTON     0xcc
#define _ITEM_TOGGLE     0xdd

#define FLAG_MSGTYPE_ALL            0x07
#define FLAG_MSGTYPE_PKT            0x01
#define FLAG_MSGTYPE_PER            0x02
#define FLAG_MSGTYPE_PING           0x04

typedef struct {
    uint8_t itemType;

    const char * const label0;
    const char * const label1;
    bool (*const read)(void);
    bool (*const push)(void);
} toggle_item_t;

typedef struct {
    uint8_t itemType;

    const char * const label;
    void (*const push)(void);
} button_item_t;

typedef struct {
    uint8_t itemType;

    unsigned width; // num columns printed

    void (*const print)(void);
    bool (*const write)(const char*); // NULL for read-only.  return true: redraw menu
} value_item_t;

typedef struct {
    uint8_t row;
    uint8_t col;
} pos_t;

typedef enum {
    MENUMODE_NONE = 0,
    MENUMODE_ENTRY,
    MENUMODE_DROPDOWN,
    MENUMODE_REDRAW,
    MENUMODE_REINIT_MENU,
} menuMode_e;

typedef struct {
    pos_t pos;  // on screen position, both row & col with 1 starting value
    const char* const label;

    const void* const itemPtr;

    uint8_t flags;

    const void* refreshReadItem;    /* other item to be read after activation */
} menu_t;

typedef struct {
    menuMode_e _mode;
    uint8_t sel_idx;
    const menu_t* sm;
    uint8_t dropdown_col;
} menuState_t;

typedef struct {
    uint8_t itemType;

    const char* const * printed_strs;   // displayed values index from read callback return
    const char* const * selectable_strs;   // choices

    unsigned (*const read)(bool forWriting);
    menuMode_e (*const write)(unsigned);
} dropdown_item_t;

extern const struct device *transceiver;

void log_printf(const char* format, ...);

class Radio {
    public:
		static const char* const chipNum_str;
		static void hw_reset(void);
		static void readChip(void);
		static void clearIrqFlags(void);
		static void test(void);
		static void tx_preamble(void);
		static void tx_carrier(void);
        static void Rx(void);
		static void txPkt(void);
		static float getMHz(void);
		static void setMHz(float);

		static const value_item_t tx_dbm_item;

		static const menu_t* get_modem_menu(void);
		static const menu_t* get_modem_sub_menu(void);
		static const menu_t common_menu[];

		static unsigned pktType_read(bool);
		static menuMode_e pktType_write(unsigned);
		static const char* const pktType_strs[];

		static const char* const opmode_status_strs[];
        static const char* const opmode_select_strs[];
        static unsigned opmode_read(bool);
        static menuMode_e opmode_write(unsigned);

        static uint8_t get_payload_length(void);
        static void set_payload_length(uint8_t);

        static unsigned tx_ramp_read(bool);
        static menuMode_e tx_ramp_write(unsigned);
        static const char* tx_ramp_strs[];

        static void tx_payload_length_print(void);
        static bool tx_payload_length_write(const char*);
#if defined(CONFIG_SEMTECH_SX126X) // or CONFIG_HAS_SEMTECH_SX126X 
		static SX126x radio;
#endif

		static unsigned read_register(unsigned);
        static void write_register(unsigned, unsigned);

        static void tx_dbm_print(void);
        static bool tx_dbm_write(const char*);

		static const menu_t lora_menu[];
		static const menu_t gfsk_menu[];

#if defined(CONFIG_SEMTECH_SX128X)
#elif defined(CONFIG_SEMTECH_SX127X)
#elif defined(CONFIG_SEMTECH_SX126X)
		static sx126x_pa_cfg_params_t pa_config;
		static sx126x_mod_params_gfsk_t mpFSK;
		static sx126x_mod_params_lora_t mpLORA;
		static void write_mpLORA(void);
		static void write_mpFSK(void);
		static sx126x_pkt_params_gfsk_t ppFSK;
		static sx126x_pkt_params_lora_t ppLORA;
		static uint8_t tx_param_buf[];
#elif defined(CONFIG_SEMTECH_LR11XX)
#endif
    private:
#if defined(CONFIG_SEMTECH_SX128X)
        #include "radio_sx128x_private.h"
#elif defined(CONFIG_SEMTECH_SX127X)
        #include "radio_sx127x_private.h"
#elif defined(CONFIG_SEMTECH_SX126X)
        #include "radio_sx126x_private.h"
#elif defined(CONFIG_SEMTECH_LR11XX)
        #include "radio_lr11xx_private.h"
#endif
};

void printf_uart(const char *format, ...);
```

## include/radio_sx126x_private.h
```c
        static bool deviceSel_read(void);
        static bool deviceSel_push(void);
        static const toggle_item_t deviceSel_item;

        static unsigned tcxoDelayTicks; // runs at 64,000Hz
        static void tcxo_delay_print(void);
        static bool tcxo_delay_write(const char*);
        static const value_item_t tcxo_delay_item;

        static unsigned paDutyCycle_read(bool);
        static menuMode_e paDutyCycle_write(unsigned sidx);
        static const dropdown_item_t paDutyCycle_item;

        static void xta_print(void);
        static bool xta_write(const char*);
        static const value_item_t xta_item;

        static void xtb_print(void);
        static bool xtb_write(const char*);
        static const value_item_t xtb_item;

        static void tcxo_volts_print(void);
        static bool tcxo_volts_write(const char*);
        static const value_item_t tcxo_volts_item;

        static unsigned rxfe_pm_read(bool);
        static menuMode_e rxfe_pm_write(unsigned sidx);
        static const dropdown_item_t rxfe_pm_item;

        static unsigned hpMax_read(bool);
        static menuMode_e hpMax_write(unsigned sidx);
        static const dropdown_item_t hpMax_item;

        static void ldo_push(void);
        static const button_item_t ldo_item;

        static void ocp_print(void);
        static bool ocp_write(const char*);
        static const value_item_t ocp_item;

        static void dcdc_push(void);
        static const button_item_t dcdc_item;

        /**************** lora: ************************/

        static unsigned lora_bw_read(bool);
        static menuMode_e lora_bw_write(unsigned sidx);
        static const dropdown_item_t lora_bw_item;

        static bool lora_inviq_read(void);
        static bool lora_inviq_push(void);
        static const toggle_item_t lora_inviq_item;

        static void lora_sf_print(void);
        static bool lora_sf_write(const char*);
        static const value_item_t lora_sf_item;

        static unsigned lora_cr_read(bool);
        static menuMode_e lora_cr_write(unsigned sidx);
        static const dropdown_item_t lora_cr_item;

        static bool lora_crcon_read(void);
        static bool lora_crcon_push(void);
        static const toggle_item_t lora_crcon_item;

        static void cad_push(void);
        static const button_item_t lora_cad_item;

        static bool lora_cadexit_read(void);
        static bool lora_cadexit_push(void);
        static const toggle_item_t lora_cadexit_item;

        static bool lora_sdmode_read(void);  
        static bool lora_sdmode_push(void);
        static const toggle_item_t lora_sdmode_item;

        static bool ppmOffset_read(void);
        static bool ppmOffset_push(void);
        static const toggle_item_t lora_ppmOffset_item;

        static void lora_pblLen_print(void);
        static bool lora_pblLen_write(const char*);
        static const value_item_t lora_pblLen_item;

        static void lora_cadpnratio_print(void);
        static bool lora_cadpnratio_write(const char*);
        static const value_item_t lora_cadpnratio_item;

        static bool lora_headerType_read(void);
        static bool lora_headerType_push(void);
        static const toggle_item_t lora_headerType_item;

        static void lora_ppg_print(void);
        static bool lora_ppg_write(const char*);
        static const value_item_t lora_ppg_item;
        static uint16_t ppg;

        static unsigned lora_cadsymbs_read(bool);
        static menuMode_e lora_cadsymbs_write(unsigned sidx);
        static const dropdown_item_t lora_cadsymbs_item;

        static void lora_cadtimeout_print(void);
        static bool lora_cadtimeout_write(const char*);
        static const value_item_t lora_cadtimeout_item;

        static void lora_cadmin_print(void);
        static bool lora_cadmin_write(const char*);
        static const value_item_t lora_cadmin_item;

		static uint8_t bw_idx;

        /**************** gfsk: ************************/

        static void gfsk_bitrate_print(void);
        static bool gfsk_bitrate_write(const char*);
        static const value_item_t gfsk_bitrate_item;

		static void gfsk_whiteInit_print(void);
        static bool gfsk_whiteInit_write(const char*);
        static const value_item_t gfsk_whiteInit_item;

        static bool gfsk_white_read(void);
        static bool gfsk_white_push(void);
        static const toggle_item_t gfsk_white_item;

        static void gfsk_syncword_print(void);
        static bool gfsk_syncword_write(const char*);
        static const value_item_t gfsk_syncword_item;

        static void gfsk_crcpoly_print(void);
        static bool gfsk_crcpoly_write(const char*);
        static const value_item_t gfsk_crcpoly_item;

        static unsigned gfsk_addrcomp_read(bool);
        static menuMode_e gfsk_addrcomp_write(unsigned sidx);
        static const dropdown_item_t gfsk_addrcomp_item;

        static void gfsk_fdev_print(void);
        static bool gfsk_fdev_write(const char*);
        static const value_item_t gfsk_fdev_item;	

        static void gfsk_crcinit_print(void);
        static bool gfsk_crcinit_write(const char*);
        static const value_item_t gfsk_crcinit_item;

        static void gfsk_nodeadrs_print(void);
        static bool gfsk_nodeadrs_write(const char*);
        static const value_item_t gfsk_nodeadrs_item;

        static unsigned gfsk_pblDetLen_read(bool);
        static menuMode_e gfsk_pblDetLen_write(unsigned sidx);
        static const dropdown_item_t gfsk_pblDetLen_item;

        static unsigned gfsk_bt_read(bool);
        static menuMode_e gfsk_bt_write(unsigned sidx);
        static const dropdown_item_t gfsk_bt_item;

        static unsigned gfsk_crctype_read(bool);
        static menuMode_e gfsk_crctype_write(unsigned sidx);
        static const dropdown_item_t gfsk_crctype_item;

        static void gfsk_broadcast_print(void);
        static bool gfsk_broadcast_write(const char*);
        static const value_item_t gfsk_broadcast_item;

        static void gfsk_pblLen_print(void);
        static bool gfsk_pblLen_write(const char*);
        static const value_item_t gfsk_pblLen_item;

        static unsigned gfsk_rxbw_read(bool);
        static menuMode_e gfsk_rxbw_write(unsigned sidx);
        static const dropdown_item_t gfsk_rxbw_item;

        static void gfsk_swl_print(void);
        static bool gfsk_swl_write(const char*);
        static const value_item_t gfsk_swl_item;

        static bool gfsk_fixLen_read(void);
        static bool gfsk_fixLen_push(void);
        static const toggle_item_t gfsk_fixLen_item;

        static uint8_t cadParams[7];
```

## include/sx126x_driver.h
```c
#define RC_TICKS_PER_MS         0.015625    /* 64KHz */
#define RC_TICKS_PER_US         15.625    /* 64KHz */

#define XTAL_FREQ_HZ            32000000
#define FREQ_DIV                33554432
#define FREQ_STEP               0.95367431640625 // ( ( double )( XTAL_FREQ / ( double )FREQ_DIV ) )
#define MHZ_TO_FRF              1048576 // = (1<<25) / Fxtal_MHz
#define KHZ_TO_FRF              1048.576
#define HZ_TO_FRF               1.048576 // = (1<<25) / Fxtal_Hz

/* direct register access */
#define REG_ADDR_IRQ_STATUS            0x58a // 16bit
#define REG_ADDR_IRQ_MASK              0x58c // 16bit
#define REG_ADDR_MODCFG                0x680 // 8bit
#define REG_ADDR_BITRATE               0x6a1 // 24bit fsk
#define REG_ADDR_FREQDEV               0x6a4 // 18bit fsk
#define REG_ADDR_SHAPECFG              0x6a7 // 5bit
#define REG_ADDR_FSK_DEMOD_CFO         0x6b0 // 12bit  center frequency offset
#define REG_ADDR_FSK_PKTCTRL0          0x6b3 // 8bit
#define REG_ADDR_FSK_PKTCTRL1          0x6b4 // 3bit
#define REG_ADDR_FSK_PREAMBLE_TXLEN    0x6b5 // 16bit
#define REG_ADDR_FSK_SYNC_LEN          0x6b7 // 7bit
#define REG_ADDR_FSK_PKTCTRL1A         0x6b8 // 14bit   5bits+9bits
#define REG_ADDR_FSK_PKTCTRL2          0x6ba // 8bit
#define REG_ADDR_FSK_PAYLOAD_LEN       0x6bb // 8bit
#define REG_ADDR_FSK_CRCINIT           0x6bc // 16bit
#define REG_ADDR_FSK_CRCPOLY           0x6be // 16bit
#define REG_ADDR_SYNCADDR              0x6c0 // 64bit fsk
#define REG_ADDR_NODEADDR              0x6cd // 8bit fsk
#define REG_ADDR_BROADCAST             0x6ce // 8bit fsk
#define REG_ADDR_NODEADDRCOMP          0x6cf // 2bit fsk

#define REG_ADDR_LORA_TXPKTLEN         0x702 // 8bit
#define REG_ADDR_LORA_CONFIG0          0x703 // 8bit  bw/sf
#define REG_ADDR_LORA_CONFIG1          0x704 // 8bit  ppm_offset, fixlen, invertiq, cr
#define REG_ADDR_LORA_CONFIG2          0x705 // 8bit  crcType
#define REG_ADDR_LORA_IRQ_MASK         0x70a // 24bit
#define REG_ADDR_LORA_CONFIG9          0x724 // 8bit
#define REG_ADDR_LORA_PREAMBLE_SYMBNB  0x73a // 16bit
#define REG_ADDR_LORA_CAD_PN_RATIO     0x73e // 8bit
#define REG_ADDR_LORA_CAD_MINPEAK      0x73f // 8bit
#define REG_ADDR_LORA_SYNC             0x740 // config22, config23: frame sync peak position
#define REG_ADDR_LORA_STATUS           0x76b //

#define REG_ADDR_DIGFECTL              0x804 // 6bits
#define REG_ADDR_BWSEL                 0x807 // 5bits
#define REG_ADDR_RANDOM                0x819 //        ro
#define REG_ADDR_PA_CTRL0              0x880 // 8bits
#define REG_ADDR_PA_CTRL1              0x881 // 8bits
#define REG_ADDR_DIG_CTRL              0x882 // 8bits
#define REG_ADDR_PWR_CTRL              0x883 // 8bits
#define REG_ADDR_I_GAIN                0x884 // 8bits  integral gain in pi filter
#define REG_ADDR_P_GAIN                0x885 // 8bits  proportional gain in pi filter
#define REG_ADDR_SDCFG0                0x889 // 
#define REG_ADDR_RFFREQ                0x88b // 31bits
#define REG_ADDR_FREQ_OFFSET           0x88f // 19bits
#define REG_ADDR_AGC_SENSI_ADJ         0x8ac // 8bits
#define REG_ADDR_ANACTRL6              0x8d7 // 6bits
#define REG_ADDR_ANACTRL7              0x8d8 // 6bits
#define REG_ADDR_ANACTRL15             0x8e1 // 7bits
#define REG_ADDR_ANACTRL16             0x8e2
#define REG_ADDR_PA_CTRL1B             0x8e6
#define REG_ADDR_OCP                   0x8e7 // 6bits   Imax        2.5mA steps
#define REG_ADDR_IMAX_OFFSET           0x8e8 // 5bits  OCP offset
#define REG_ADDR_XTA_TRIM              0x911 // crystal trim only in xosc
#define REG_ADDR_XTB_TRIM              0x912 // crystal trim only in xosc
#define REG_ADDR_                      0x

/*#define GFSK_SHAPE_NONE             0x00
#define GFSK_SHAPE_BT0_3            0x08
#define GFSK_SHAPE_BT0_5            0x09
#define GFSK_SHAPE_BT0_7            0x0a
#define GFSK_SHAPE_BT1_0            0x0b*/

#define GFSK_CRC_OFF            0x01
#define GFSK_CRC_1_BYTE         0x00
#define GFSK_CRC_2_BYTE         0x02
#define GFSK_CRC_1_BYTE_INV     0x04
#define GFSK_CRC_2_BYTE_INV     0x06

#define LORA_BW_7           0x00 // 7.81 kHz real
#define LORA_BW_10          0x08 // 10.42 kHz real
#define LORA_BW_15          0x01 // 15.63 kHz real
#define LORA_BW_20          0x09 // 20.83 kHz real
#define LORA_BW_31          0x02 // 31.25 kHz real
#define LORA_BW_41          0x0A // 41.67 kHz real
#define LORA_BW_62          0x03 // 62.50 kHz real
#define LORA_BW_125         0x04 // 125 kHz real
#define LORA_BW_250         0x05 // 250 kHz real
#define LORA_BW_500         0x06 // 500 kHz real

/*#define GFSK_RX_BW_4800             0x1F 
#define GFSK_RX_BW_5800             0x17 
#define GFSK_RX_BW_7300             0x0F 
#define GFSK_RX_BW_9700             0x1E 
#define GFSK_RX_BW_11700            0x16 
#define GFSK_RX_BW_14600            0x0E 
#define GFSK_RX_BW_19500            0x1D 
#define GFSK_RX_BW_23400            0x15 
#define GFSK_RX_BW_29300            0x0D 
#define GFSK_RX_BW_39000            0x1C 
#define GFSK_RX_BW_46900            0x14 
#define GFSK_RX_BW_58600            0x0C 
#define GFSK_RX_BW_78200            0x1B 
#define GFSK_RX_BW_93800            0x13 
#define GFSK_RX_BW_117300           0x0B 
#define GFSK_RX_BW_156200           0x1A 
#define GFSK_RX_BW_187200           0x12 
#define GFSK_RX_BW_234300           0x0A 
#define GFSK_RX_BW_312000           0x19 
#define GFSK_RX_BW_373600           0x11 
#define GFSK_RX_BW_467000           0x09 */

typedef union {
    struct {
        uint8_t mod_order :  2; // 0,1   modulation size      2points to 16points
        uint8_t mod_type  :  2; // 2,3   IQ, FSK, MSK, LoRa
        uint8_t data_src  :  1; // 4     
        uint8_t clk_src   :  2; // 5,6
        uint8_t mod_en    :  1; // 7
    } bits;
    uint8_t octet;
} modCfg_t;  // at 0x680  fsk

typedef union {
    struct {
        uint8_t bt           :  2; // 0,1    0=BT0.3   1=BT0.5   2=BT0.7  3=BT1.0
        uint8_t double_rate  :  1; // 2      double oversampling rate
        uint8_t pulse_shape  :  2; // 3,4    0=noFilter  1=gaussian   2=RRC
        uint8_t res          :  3; // 5,6,7
    } bits;
    uint8_t octet;
} shapeCfg_t;  // at 0x6a7 fsk

typedef union {
    struct {
        uint8_t pkt_start_p    :  1; // 0   ros1
        uint8_t pkt_abort_p    :  1; // 1   ros1
        uint8_t pkt_sw_clr_p   :  1; // 2   ros1
        uint8_t crl_status_p   :  1; // 3   ros1
        uint8_t clk_en         :  1; // 4   ro
        uint8_t pkt_rx_ntx     :  1; // 5
        uint8_t pkt_len_format :  1; // 6
        uint8_t cont_rx        :  1; // 7
    } bits;
    uint8_t octet;
} pktCtrl0_t;  // at 0x6b3 fsk

typedef union {
    struct {
        uint8_t preamble_len_rx :  2; // 0,1   number of preamble bits detected
        uint8_t preamble_det_on :  1; // 2   enable rx-sde preamble detector
        uint8_t res             :  5; // 7
    } bits;
    uint8_t octet;
} pktCtrl1_t;  // at 0x6b4 fsk

typedef union {
    struct {
        uint16_t whit_init_val       : 9; // 0...8     at 0x6b9
        uint16_t infinite_seq_en     : 1; // 9
        uint16_t infinite_seq_select : 2; // 10,11
        uint16_t cont_tx             : 1; // 12
        uint16_t sync_det_on         : 1; // 13
        uint16_t res                 : 2; // 14,15
    } bits;
    uint16_t word;
} PktCtrl1a_t;  // at 0x6b8

typedef union {
    struct {
        uint8_t crc_disable    :  1; // 0
        uint8_t crc_len        :  1; // 1     0=1byte  1=2byte
        uint8_t crc_inv        :  1; // 2
        uint8_t crc_in_fifo    :  1; // 3
        uint8_t whit_enable    :  1; // 4
        uint8_t manchester_en  :  1; // 5
        uint8_t rssi_mode      :  2; // 6,7
    } bits;
    uint8_t octet;
} pktCtrl2_t;  // at 0x6ba fsk


typedef union {
    struct {
        uint8_t modem_sf:  4; // 0,1,2,3
        uint8_t modem_bw:  4; // 4,5,6,7
    } bits;
    uint8_t octet;
} loraConfig0_t;  // at 0x703

typedef union {
    struct {
        uint8_t tx_coding_rate :  3; // 0,1,2
        uint8_t ppm_offset      : 2; // 3,4     aka long range mode
        uint8_t tx_mode         : 1; // 5
        uint8_t rx_invert_iq    : 1; // 6
        uint8_t implicit_header : 1; // 7     0=variable length packet
    } bits;
    uint8_t octet;
} loraConfig1_t;  // at 0x704

typedef union {
    struct {
        uint8_t cad_rxtx               :  2; // 0,1
        uint8_t tx_payload_crc16_en    :  1; // 2
        uint8_t cont_rx                :  1; // 3
        uint8_t freeze_dagc_upon_synch :  2; // 4,5
        uint8_t fine_sync_en           :  1; // 6
        uint8_t res                    :  1; // 7
    } bits;
    uint8_t octet;
} loraConfig2_t;  // at 0x705

typedef union {
    struct {
        uint32_t est_freq_error               :20; // 0..19
        uint32_t header_crc16_en              : 1; // 20
        uint32_t rf_en_request                : 2; // 21,22
        uint32_t raw_ranging_result_available : 1; // 23
        uint32_t unused                       : 8; // 24..31
    } bits;
    uint32_t dword;
} loraStatus1_t;  // at 0x76b

typedef union {
    struct {
        uint8_t inv_edge        : 1; // 0
        uint8_t swap_iq         : 1; // 1
        uint8_t dig_fe_clear    : 1; // 2
        uint8_t lora_ngfsk      : 1; // 3   data buffer selection lora/gfsk
        uint8_t adc_from_dio    : 1; // 4
        uint8_t lora_pre_cf_en  : 1; // 5
        uint8_t res             : 2; // 6,7
    } bits;
    uint8_t octet;
} digFeCtrl_t;  // at 0x804

typedef union {
    struct {
        uint8_t exp  : 3; // 0,1,2
        uint8_t mant : 2; // 3,4
        uint8_t res  : 3; // 5,6,7
    } bits;
    uint8_t octet;
} bwSel_t;  // at 0x807   rx_bw

typedef union {
    struct {
        uint8_t reg_pa_discharge_en : 1; // 0
        uint8_t reg_pa_boost_en     : 1; // 1
        uint8_t dac_pol             : 2; // 2,3
    } bits;
    uint8_t octet;
} paCtrl0_t;  // at 0x880

typedef union {
    struct {
        uint8_t boost_delay : 6; // 0,1,2,3,4,5
        uint8_t boost_width : 2; // 6,7
    } bits;
    uint8_t octet;
} paCtrl1_t;  // at 0x881

typedef union {
    struct {
        uint8_t ramp_on           : 1; // 0
        uint8_t ramp_down         : 1; // 1
        uint8_t ramp_up           : 1; // 2
        uint8_t ramp_status       : 1; // 3
        uint8_t force_dac_code_en : 1; // 4
        uint8_t pa_mod_en         : 1; // 5
    } bits;
    uint8_t octet;
} DigCtrl_t;  // at 0x882

typedef union {
    struct {
        uint8_t tx_pwr    : 5; // 0,1,2,3,4
        uint8_t ramp_time : 3; // 5,6,7
    } bits;
    uint8_t octet;
} PwrCtrl_t;  // at 0x883

typedef union {
    struct {
        uint8_t phase_step:     2; // 0,1
        uint8_t sd_mode:        1; // 2
        uint8_t sd_en:          1; // 3
        uint8_t div_ratio_edge: 1; // 4
        uint8_t reserved:       3; // 5,6,7
    } bits;
    uint8_t octet;
} sdCfg0_t;  // at 0x889

typedef union {
    struct {
        uint8_t power_mode:     2; // 0,1
        uint8_t sensi_adjust:   6; // 2,3,4,5,6,7
    } bits;
    uint8_t octet;
} AgcSensiAdj_t;  // at 0x8ac

typedef union {
    struct {
        uint8_t pa_hp_ena_ana        : 1; // 0
        uint8_t tx_ena_bat           : 1; // 1
        uint8_t pa_dctrim_select_ana : 4; // 2,3,4,5        paDutyCycle
        uint8_t res                  : 2; // 6,7
    } bits;
    uint8_t octet;
} AnaCtrl6_t;  // at 0x8d7

typedef union {
    struct {
        uint8_t pa_lp_ena_ana         : 1; // 0
        uint8_t pa_clamp_code_bat     : 3; // 1,2,3
        uint8_t pa_clamp_override_bat : 1; // 4
        uint8_t pa_hp_sel_ana         : 3; // 5,6,7     hpMax
    } bits;
    uint8_t octet;
} AnaCtrl7_t;  // at 0x8d8

typedef union {
    struct {
        uint8_t reg_pa_comp_poarity_ana  : 1; // 0
        uint8_t reg_pa_comp_en_ana       : 1; // 1
        uint8_t fir_dac_sign_ana         : 2; // 2,3
        uint8_t fir_dac_pole_ana         : 3; // 4,5,6
        uint8_t res                      : 1; // 7
    } bits;
    uint8_t octet;
} AnaCtrl15_t;  // at 0x8e1

typedef union {
    struct {
        uint8_t force_ref         : 1; // 0
        uint8_t pa_voltage_lim_en : 1; // 1
        uint8_t pa_current_lim_en : 1; // 2
        uint8_t tx_mode_bat       : 1; // 3  deviceSel  0=hipower   1=lopower  take precedence over hpp_mode
        uint8_t hp_mode           : 1; // 4 hi-power submode  0=14dBm LUT,   1=20dBm LUT
    } bits;
    uint8_t octet;
} PaCtrl1b_t;  // at 0x8e6

typedef union {
    struct {
        uint8_t spreadingFactor; // param1
        uint8_t bandwidth; // param2
        uint8_t codingRate; // param3
        uint8_t LowDatarateOptimize; // param4
    } lora;
    struct {
        uint8_t bitrateHi;  // param1
        uint8_t bitrateMid; // param2
        uint8_t bitrateLo;  // param3
        uint8_t PulseShape; // param4
        uint8_t bandwidth;  // param5
        uint8_t fdevHi;     // param6
        uint8_t fdevMid;    // param7
        uint8_t fdevLo;     // param8
    } gfsk;
    uint8_t buf[8];
} ModulationParams_t;

typedef union {
    struct {
        uint8_t PreambleLengthHi;   // param1
        uint8_t PreambleLengthLo;   // param2
        uint8_t HeaderType;         // param3
        uint8_t PayloadLength;      // param4
        uint8_t CRCType;            // param5
        uint8_t InvertIQ;           // param6
        uint8_t unused[2];
    } lora;
    struct {
        uint8_t PreambleLengthHi;       // param1
        uint8_t PreambleLengthLo;       // param2
        uint8_t PreambleDetectorLength; // param3
        uint8_t SyncWordLength;         // param4
        uint8_t AddrComp;               // param5
        uint8_t PacketType;             // param6
        uint8_t PayloadLength;          // param7
        uint8_t CRCType;                // param8
        uint8_t Whitening;              // param9
    } gfsk;
    uint8_t buf[9];
} PacketParams_t;

typedef union {
    struct {    // 
        uint16_t TxDone           : 1;    // 0
        uint16_t RxDone           : 1;    // 1
        uint16_t PreambleDetected : 1;    // 2
        uint16_t SyncWordValid    : 1;    // 3
        uint16_t HeaderValid      : 1;    // 4
        uint16_t HeaderErr        : 1;    // 5
        uint16_t CrCerr           : 1;    // 6
        uint16_t CadDone          : 1;    // 7
        uint16_t CadDetected      : 1;    // 8
        uint16_t Timeout          : 1;    // 9
        uint16_t res              : 6;    // 10,11,12,13,14,15
    } bits;
    uint16_t word;
} IrqFlags_t;

class SX126x {
    public:
		SX126x();

		uint8_t setMHz(float);
		float getMHz(void);
		//! RF transmit packet buffer
        uint8_t tx_buf[256];    // lora fifo size
		//void setCAD(void);
};
```

## src/sx126x.cpp
```c
#include <cstdint>
#include <sx126x_driver.h>

SX126x::SX126x()
{
}


uint8_t SX126x::setMHz(float MHz)
{
    /*unsigned frf = MHz * MHZ_TO_FRF;
    uint8_t buf[4];

    buf[0] = frf >> 24;
    buf[1] = frf >> 16;
    buf[2] = frf >> 8;
    buf[3] = frf;
    xfer(OPCODE_SET_RF_FREQUENCY, 4, 0, buf);
    return buf[3];*/
	//yyy TODO
	return 0;
}

float SX126x::getMHz()
{
    /*uint32_t frf = readReg(REG_ADDR_RFFREQ, 4);
    return frf / (float)MHZ_TO_FRF;*/
	// yyy TODO
	return 0;
}
```
