## Kconfig
```kconfig
# Copyright (c) 2021 Nordic Semiconductor ASA
# SPDX-License-Identifier: Apache-2.0
#
# This Kconfig file is picked by the Zephyr build system because it is defined
# as the module Kconfig entry point (see zephyr/module.yml). You can browse
# module options by going to Zephyr -> Modules in Kconfig.

choice RADIO
    prompt "radio driver built from source"
    default RADIO_SX126X
    help
        select the radio driver built from source

config RADIO_SX126X
    bool "Enable sx126x radio"
    help
        Use sx126x

config RADIO_LR11XX
    bool "Enable LR11xx radio & remove sx126x"
    help
        Use LR11xx radio device instead of sx126x

endchoice # RADIO

rsource "drivers/Kconfig"
rsource "lib/Kconfig"
```

## west.yml
```yaml
# Copyright (c) 2021 Nordic Semiconductor ASA
# SPDX-License-Identifier: Apache-2.0

manifest:
  self:
    west-commands: scripts/west-commands.yml

  remotes:
    - name: zephyrproject-rtos
      url-base: https://github.com/zephyrproject-rtos
    - name: lora-net
      url-base: https://github.com/Lora-net

  projects:
    - name: zephyr
      remote: zephyrproject-rtos
      revision: main
      import:
        # By using name-allowlist we can clone only the modules that are
        # strictly needed by the application.
        name-allowlist:
          - cmsis      # required by the ARM port
          - hal_nordic # required by the custom_plank board (Nordic based)
          - hal_stm32  # required by the nucleo_f302r8 board (STM32 based)
          - loramac-node
    - name: lbm_zephyr
      path: modules/lbm_zephyr
      remote: lora-net
      repo-path: lbm_zephyr
      revision: master
      import: true
```
